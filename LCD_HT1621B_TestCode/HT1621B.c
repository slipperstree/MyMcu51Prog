
#include <at89x52.h>
#include "HT1621B.h"

/**-------------------------------------------------------------------------
Name: SendBit_1621(送数据程序)
---------------------------------------------------------------------------*/
void SendBit_1621(uchar sdata,uchar cnt) //sdata 的高cnt 位写入HT1621，高位在前
{
	uchar i;
	for(i=0;i<cnt;i++)
	{
		WR1=0;	 
		if(sdata&0x80) DATA1=1;
		else DATA1=0;
		WR1=1;
		sdata<<=1;
	}
}

/**-------------------------------------------------------------------------
Name: SendCmd(送命令)
---------------------------------------------------------------------------*/
void SendCmd_1621(uchar command)
{
	CS1=0;
	SendBit_1621(0x80,4);    //写入标志码“100”和9 位command 命令，由于
	SendBit_1621(command,8); //没有使有到更改时钟输出等命令，为了编程方便
	CS1=1;                   //直接将command 的最高位写“0”
}

/**-------------------------------------------------------------------------
Name: Write_1621(送数据和命令程序)
---------------------------------------------------------------------------*/
void Write_1621(uchar addr,uchar sdata,uchar len)
{
	addr<<=2;
	CS1=0;
	SendBit_1621(0xa0,3);  //写入标志码“101”
	SendBit_1621(addr,6);  //写入addr 的高6位
	SendBit_1621(sdata,len); //写入data 的高len位
	CS1=1;
}

/**-------------------------------------------------------------------------
Name: all_off(清除1621显示)
---------------------------------------------------------------------------*/
void HT1621_all_off(void)
{ 
	uchar i;
	uchar addr=0;
	for(i=0;i<SEG_NUM;i++)
	{
		Write_1621(addr,0x00,8);
		addr+=2;
	}
}

/**-------------------------------------------------------------------------
Name: all_on(点亮1621全部Seg)
-------------------------------------------------------------------------*/
void HT1621_all_on(void)
{ 
	uchar i;
	uchar addr=0;
	for(i=0;i<SEG_NUM;i++)
	{
		Write_1621(addr,0xff,8);
		addr+=2;
	}
}

/**-------------------------------------------------------------------------
Name: Init_1621(初始化1621)
-------------------------------------------------------------------------*/
void Init_1621(void)
{
	SendCmd_1621(Sys_en);
	SendCmd_1621(RCosc);
	SendCmd_1621(ComMode);
	SendCmd_1621(LCD_on);
}
/**-------------------------------------------------------------------------
Name: LCDoff(初始化1621)
-------------------------------------------------------------------------*/
void LCDoff(void)
{
	SendCmd_1621(LCD_off);
}
/**-------------------------------------------------------------------------
Name: LCDon(初始化1621)
-------------------------------------------------------------------------*/
void LCDon(void)
{
	SendCmd_1621(LCD_on);
}
